## gpio/Config.in
```kconfig
config AOS_APP_GPIO
    bool "Gpio"
    select AOS_COMP_OSAL_AOS
    help
        gpio

if AOS_APP_GPIO
# Configurations for app gpio
endif
```

## myapp1/Config.in
```kconfig
config AOS_APP_MYAPP1
    bool "Myapp1"
    select AOS_COMP_OSAL_AOS
    help
        myapp1

if AOS_APP_MYAPP1
# Configurations for app myapp1
endif
```
